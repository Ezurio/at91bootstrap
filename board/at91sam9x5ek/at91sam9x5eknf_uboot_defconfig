## board/at91sam9x5ek/at91sam9x5eknf_uboot_defconfig
```kconfig
CONFIG_AT91SAM9X5EK=y
CONFIG_NANDFLASH=y
# CONFIG_PMECC_AUTO_DETECT is not set
CONFIG_PMECC_CORRECT_BITS_4=y
# CONFIG_NANDFLASH_RECOVERY is not set
# CONFIG_USE_ON_DIE_ECC_SUPPORT is not set
CONFIG_IMG_ADDRESS="0x00020000"
CONFIG_JUMP_ADDR="0x23f00000"
CONFIG_IMG_SIZE="0x00060000"
CONFIG_DEBUG=y
CONFIG_DEBUG_VERY_LOUD=y
CONFIG_THUMB=y
CONFIG_SCLK=y
CONFIG_LOAD_ONE_WIRE=y
```

## board/sama5d3xek/sama5d3xeknf_uboot_defconfig
```kconfig
CONFIG_SAMA5D3XEK=y
CONFIG_CPU_CLK_528MHZ=y
CONFIG_NANDFLASH=y
# CONFIG_PMECC_AUTO_DETECT is not set
CONFIG_PMECC_CORRECT_BITS_4=y
# CONFIG_USE_ON_DIE_ECC_SUPPORT is not set
CONFIG_IMG_ADDRESS="0x00020000"
CONFIG_JUMP_ADDR="0x23f00000"
CONFIG_MEMTEST=y
CONFIG_DEBUG=y
CONFIG_DEBUG_VERY_LOUD=y
CONFIG_SCLK=y
# CONFIG_LOAD_ONE_WIRE is not set
```

## board/wb45n/wb45n_uboot_defconfig
```kconfig
CONFIG_WB45N=y
CONFIG_LPDDR1=y
CONFIG_NANDFLASH=y
# CONFIG_PMECC_AUTO_DETECT is not set
CONFIG_PMECC_CORRECT_BITS_4=y
# CONFIG_NANDFLASH_RECOVERY is not set
# CONFIG_USE_ON_DIE_ECC_SUPPORT is not set
CONFIG_IMG_ADDRESS="0x00020000"
CONFIG_JUMP_ADDR="0x23f00000"
CONFIG_DEBUG=y
# CONFIG_DISABLE_WATCHDOG is not set
CONFIG_THUMB=y
CONFIG_SCLK=y
```

## board/wb50n/wb50n_uboot_defconfig
```kconfig
CONFIG_WB50N=y
CONFIG_CPU_CLK_528MHZ=y
CONFIG_NANDFLASH=y
CONFIG_LPDDR1=y
# CONFIG_PMECC_AUTO_DETECT is not set
CONFIG_PMECC_CORRECT_BITS_8=y
# CONFIG_USE_ON_DIE_ECC_SUPPORT is not set
CONFIG_IMG_ADDRESS="0x00020000"
CONFIG_JUMP_ADDR="0x23f00000"
CONFIG_MEMTEST=y
CONFIG_DEBUG=y
# CONFIG_DISABLE_WATCHDOG is not set
CONFIG_SCLK=y
CONFIG_SCLK_BYPASS=y
```

## contrib/board/laird/wb40n/wb40n_uboot_defconfig
```kconfig
CONFIG_WB40N=y
CONFIG_RAM_32MB=y
CONFIG_SDRAM_16BIT=y
# CONFIG_NANDFLASH_RECOVERY is not set
# CONFIG_USE_ON_DIE_ECC_SUPPORT is not set
CONFIG_IMG_ADDRESS="0x00020000"
CONFIG_JUMP_ADDR="0x21000000"
CONFIG_IMG_SIZE="0x00080000"
CONFIG_DEBUG=y
# CONFIG_DISABLE_WATCHDOG is not set
CONFIG_THUMB=y
CONFIG_USER_HW_INIT=y
```
